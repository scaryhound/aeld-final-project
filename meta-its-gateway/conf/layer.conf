## meta-its-gateway/conf/layer.conf
```bitbake
BBPATH .= ":${LAYERDIR}"

# We have recipes-* directories, add to BBFILES
BBFILES += "${LAYERDIR}/recipes-*/*/*.bb \
            ${LAYERDIR}/recipes-*/*/*.bbappend"

BBFILE_COLLECTIONS += "meta-its-gateway"
BBFILE_PATTERN_meta-its-gateway = "^${LAYERDIR}/"
BBFILE_PRIORITY_meta-its-gateway = "6"

LAYERDEPENDS_meta-its-gateway = "core"
LAYERSERIES_COMPAT_meta-its-gateway = "kirkstone"
EOF
```
